## CMakeLists.txt
```
# SPDX-FileCopyrightText: 2026 Embetrix Embedded Systems Solutions <ayoub.zaki@embetrix.com>
# SPDX-License-Identifier: Apache-2.0

cmake_minimum_required(VERSION 3.28.0)
find_package(Zephyr REQUIRED HINTS $ENV{ZEPHYR_BASE})
project(leancrypto)

target_sources(app PRIVATE src/test_support.c)

if(CONFIG_TEST_LEANCRYPTO_ALL)
  foreach(family IN ITEMS kem dsa)
    if(family STREQUAL "kem")
      set(parameter_sets 512 768 1024)
      set(source_file "src/main.c")
      set(parameter_macro "TEST_KEM_BITS")
    else()
      set(parameter_sets 44 65 87)
      set(source_file "src/mldsa.c")
      set(parameter_macro "TEST_DSA_BITS")
    endif()
    foreach(bits IN LISTS parameter_sets)
      set(test_target "leancrypto_test_${family}_${bits}")
      add_library(${test_target} OBJECT "${source_file}")
      add_dependencies(${test_target} zephyr_generated_headers)
      target_link_libraries(${test_target} PRIVATE zephyr_interface)
      if(NOT CONFIG_TEST_LEANCRYPTO_BASELINE)
        target_link_libraries(${test_target} PRIVATE leancrypto)
      endif()
      target_compile_definitions(${test_target} PRIVATE
        "${parameter_macro}=${bits}"
        "TEST_SUITE_NAME=leancrypto_ml_${family}_${bits}"
      )
      target_sources(app PRIVATE "$<TARGET_OBJECTS:${test_target}>")
    endforeach()
  endforeach()
elseif(CONFIG_TEST_LEANCRYPTO_ML_DSA)
  target_sources(app PRIVATE src/mldsa.c)
else()
  target_sources(app PRIVATE src/main.c)
endif()
if(NOT CONFIG_TEST_LEANCRYPTO_BASELINE)
  target_link_libraries(app PRIVATE leancrypto)
  zephyr_ld_options(-Wl,--wrap=z_impl_sys_csrand_get)
endif()
```

## Kconfig
```
# SPDX-FileCopyrightText: 2026 Embetrix Embedded Systems Solutions <ayoub.zaki@embetrix.com>
# SPDX-License-Identifier: Apache-2.0

source "Kconfig.zephyr"

config TEST_LEANCRYPTO_BASELINE
	bool "Build the measurement harness without LeanCrypto"

config TEST_LEANCRYPTO_ALL
	bool "Test all six parameter sets in one image"
	depends on (LEANCRYPTO_ML_KEM_512 && LEANCRYPTO_ML_KEM_768 && LEANCRYPTO_ML_KEM_1024 && \
		LEANCRYPTO_ML_DSA_44 && LEANCRYPTO_ML_DSA_65 && LEANCRYPTO_ML_DSA_87) || \
		TEST_LEANCRYPTO_BASELINE
	help
	  Run all ML-KEM and ML-DSA tests sequentially, reusing one worker
	  stack. Each parameter set retains its own caller buffers.

config TEST_LEANCRYPTO_STACK_SIZE
	int "Cryptographic operation thread stack budget"
	default 163840 if TEST_LEANCRYPTO_ML_DSA || TEST_LEANCRYPTO_ALL
	default 24576
	range 16384 262144

choice TEST_LEANCRYPTO_PARAMETER_SET
	prompt "Parameter set under test"
	depends on !TEST_LEANCRYPTO_ALL
	default TEST_LEANCRYPTO_ML_KEM_768

config TEST_LEANCRYPTO_ML_KEM_512
	bool "ML-KEM-512"
	depends on LEANCRYPTO_ML_KEM_512 || TEST_LEANCRYPTO_BASELINE

config TEST_LEANCRYPTO_ML_KEM_768
	bool "ML-KEM-768"
	depends on LEANCRYPTO_ML_KEM_768 || TEST_LEANCRYPTO_BASELINE

config TEST_LEANCRYPTO_ML_KEM_1024
	bool "ML-KEM-1024"
	depends on LEANCRYPTO_ML_KEM_1024 || TEST_LEANCRYPTO_BASELINE

config TEST_LEANCRYPTO_ML_DSA_44
	bool "ML-DSA-44"
	depends on LEANCRYPTO_ML_DSA_44 || TEST_LEANCRYPTO_BASELINE

config TEST_LEANCRYPTO_ML_DSA_65
	bool "ML-DSA-65"
	depends on LEANCRYPTO_ML_DSA_65 || TEST_LEANCRYPTO_BASELINE

config TEST_LEANCRYPTO_ML_DSA_87
	bool "ML-DSA-87"
	depends on LEANCRYPTO_ML_DSA_87 || TEST_LEANCRYPTO_BASELINE

endchoice

config TEST_LEANCRYPTO_ML_DSA
	def_bool TEST_LEANCRYPTO_ML_DSA_44 || TEST_LEANCRYPTO_ML_DSA_65 || TEST_LEANCRYPTO_ML_DSA_87
```

## prj.conf
```kconfig
# SPDX-FileCopyrightText: 2026 Embetrix Embedded Systems Solutions <ayoub.zaki@embetrix.com>
# SPDX-License-Identifier: Apache-2.0

CONFIG_ZTEST=y
CONFIG_LEANCRYPTO=y
CONFIG_CSPRNG_NEEDED=y
CONFIG_INIT_STACKS=y
CONFIG_THREAD_STACK_INFO=y
CONFIG_THREAD_MONITOR=y
CONFIG_STACK_SENTINEL=y
CONFIG_HEAP_MEM_POOL_SIZE=0
```

## combined.conf
```kconfig
# SPDX-FileCopyrightText: 2026 Embetrix Embedded Systems Solutions <ayoub.zaki@embetrix.com>
# SPDX-License-Identifier: Apache-2.0

CONFIG_LEANCRYPTO_ML_KEM_512=y
CONFIG_LEANCRYPTO_ML_KEM_768=y
CONFIG_LEANCRYPTO_ML_KEM_1024=y
CONFIG_LEANCRYPTO_ML_DSA_44=y
CONFIG_LEANCRYPTO_ML_DSA_65=y
CONFIG_LEANCRYPTO_ML_DSA_87=y
CONFIG_TEST_LEANCRYPTO_ALL=y
```

## boards/mps2_an385.conf
```kconfig
# SPDX-FileCopyrightText: 2026 Embetrix Embedded Systems Solutions <ayoub.zaki@embetrix.com>
# SPDX-License-Identifier: Apache-2.0

CONFIG_TEST_CSPRNG_GENERATOR=y
CONFIG_TEST_RANDOM_GENERATOR=y
CONFIG_STACK_SENTINEL=n
CONFIG_MPU_STACK_GUARD=y
```

## boards/nucleo_f429zi.conf
```kconfig
# SPDX-FileCopyrightText: 2026 Embetrix Embedded Systems Solutions <ayoub.zaki@embetrix.com>
# SPDX-License-Identifier: Apache-2.0

CONFIG_STACK_SENTINEL=n
CONFIG_MPU_STACK_GUARD=y
```

## boards/stm32f769i_disco.overlay
```dts
/*
 * SPDX-FileCopyrightText: 2026 Embetrix Embedded Systems Solutions <ayoub.zaki@embetrix.com>
 * SPDX-License-Identifier: Apache-2.0
 */

&rng {
	status = "okay";
};
```

## src/main.c
```c
/*
 * SPDX-FileCopyrightText: 2026 Embetrix Embedded Systems Solutions <ayoub.zaki@embetrix.com>
 * SPDX-License-Identifier: Apache-2.0
 */

#include <zephyr/kernel.h>
#include <zephyr/random/random.h>
#include <zephyr/ztest.h>

#include "test_support.h"

#ifndef TEST_KEM_BITS
#if defined(CONFIG_TEST_LEANCRYPTO_ML_KEM_512)
#define TEST_KEM_BITS 512
#elif defined(CONFIG_TEST_LEANCRYPTO_ML_KEM_1024)
#define TEST_KEM_BITS 1024
#else
#define TEST_KEM_BITS 768
#endif
#endif

#ifndef TEST_SUITE_NAME
#define TEST_SUITE_NAME leancrypto
#endif

#ifndef CONFIG_TEST_LEANCRYPTO_BASELINE
#if TEST_KEM_BITS == 512
#include <lc_kyber_512.h>
#elif TEST_KEM_BITS == 1024
#include <lc_kyber_1024.h>
#else
#include <lc_kyber_768.h>
#endif
#include <lc_hash.h>
#include <lc_sha3.h>
#include "kat.h"
#endif

#if TEST_KEM_BITS == 512
#define TEST_KEM(name) lc_kyber_512_##name
#define TEST_PK_SIZE 800
#define TEST_SK_SIZE 1632
#define TEST_CT_SIZE 768
#elif TEST_KEM_BITS == 1024
#define TEST_KEM(name) lc_kyber_1024_##name
#define TEST_PK_SIZE 1568
#define TEST_SK_SIZE 3168
#define TEST_CT_SIZE 1568
#else
#define TEST_KEM(name) lc_kyber_768_##name
#define TEST_PK_SIZE 1184
#define TEST_SK_SIZE 2400
#define TEST_CT_SIZE 1088
#endif

enum operation {
	KEYGEN,
	ENCAPSULATE,
	DECAPSULATE,
};

/* Identical caller-owned storage in the crypto and baseline images. */
struct buffers {
	uint8_t pk[TEST_PK_SIZE];
	uint8_t sk[TEST_SK_SIZE];
	uint8_t ct[TEST_CT_SIZE];
	uint8_t enc_ss[32];
	uint8_t dec_ss[32];
};

static struct buffers *test_buffers(void)
{
	static struct buffers buffers __aligned(8);

	return &buffers;
}

struct job {
	enum operation operation;
	struct buffers *buffers;
	int result;
	uint32_t cycles;
};

#ifndef CONFIG_TEST_LEANCRYPTO_BASELINE
BUILD_ASSERT(sizeof(struct TEST_KEM(pk)) == sizeof(((struct buffers *)0)->pk));
BUILD_ASSERT(sizeof(struct TEST_KEM(sk)) == sizeof(((struct buffers *)0)->sk));
BUILD_ASSERT(sizeof(struct TEST_KEM(ct)) == sizeof(((struct buffers *)0)->ct));
BUILD_ASSERT(sizeof(struct TEST_KEM(ss)) == sizeof(((struct buffers *)0)->enc_ss));

static int fixed_generate(void *state, const uint8_t *additional,
			  size_t additional_len, uint8_t *out, size_t len)
{
	size_t *offset = state;

	ARG_UNUSED(additional);
	ARG_UNUSED(additional_len);
	if (len > sizeof(kat_random) - *offset) {
		return -ENODATA;
	}
	memcpy(out, &kat_random[*offset], len);
	*offset += len;
	return 0;
}

static void check_digest(const uint8_t *data, size_t len, const uint8_t *expected)
{
	uint8_t digest[32];

	zassert_ok(lc_hash(lc_sha3_256, data, len, digest));
	zassert_mem_equal(digest, expected, sizeof(digest));
}
#endif

static void operation_entry(void *arg, void *unused1, void *unused2)
{
	struct job *job = arg;
	struct buffers *b = job->buffers;

	ARG_UNUSED(unused1);
	ARG_UNUSED(unused2);
	job->cycles = k_cycle_get_32();
#ifdef CONFIG_TEST_LEANCRYPTO_BASELINE
	/* Retain all caller buffers and the same CSPRNG in the baseline. */
	job->result = sys_csrand_get(b, sizeof(*b));
#else
	switch (job->operation) {
	case KEYGEN:
		job->result = TEST_KEM(keypair)((struct TEST_KEM(pk) *)b->pk,
						 (struct TEST_KEM(sk) *)b->sk, NULL);
		break;
	case ENCAPSULATE:
		job->result = TEST_KEM(enc)((struct TEST_KEM(ct) *)b->ct,
					     (struct TEST_KEM(ss) *)b->enc_ss,
					     (const struct TEST_KEM(pk) *)b->pk);
		break;
	case DECAPSULATE:
		job->result = TEST_KEM(dec)((struct TEST_KEM(ss) *)b->dec_ss,
					     (const struct TEST_KEM(ct) *)b->ct,
					     (const struct TEST_KEM(sk) *)b->sk);
		break;
	}
#endif
	job->cycles = k_cycle_get_32() - job->cycles;
}

static int run_operation(enum operation operation, struct buffers *buffers, const char *mode)
{
	static const char *const names[] = {"keygen", "encapsulate", "decapsulate"};
	struct job job = {.operation = operation, .buffers = buffers, .result = -EINPROGRESS};
	size_t unused;
	size_t usable;

	/* Recreating a joined thread repaints the entire stack with CONFIG_INIT_STACKS. */
	k_thread_create(&test_operation_thread, test_operation_stack,
			K_THREAD_STACK_SIZEOF(test_operation_stack), operation_entry,
			&job, NULL, NULL, K_PRIO_PREEMPT(1), 0, K_FOREVER);
	usable = test_operation_thread.stack_info.size;
	k_thread_start(&test_operation_thread);
	zassert_ok(k_thread_join(&test_operation_thread, K_SECONDS(60)));
	zassert_ok(k_thread_stack_space_get(&test_operation_thread, &unused));
	zassert_true(unused <= usable);
	zassert_true(unused >= 256U, "Insufficient stack headroom");
	printk("LC_STACK mode=%s op=%s peak=%zu usable=%zu reserved=%zu caller=%zu heap=0\n",
	       mode, names[operation], usable - unused, usable, sizeof(test_operation_stack),
	       sizeof(*buffers));
	printk("LC_TIME mode=%s op=%s cycles=%u duration_us=%llu result=%d\n",
	       mode, names[operation], job.cycles,
	       (unsigned long long)k_cyc_to_us_floor64(job.cycles), job.result);
	return job.result;
}

static void *suite_setup(void)
{
	struct buffers *buffers = test_buffers();

	printk("LC_PARAMETER_SET ML-KEM-%d\n", TEST_KEM_BITS);
	printk("LC_BUFFERS unit=bytes pk=%zu sk=%zu ct=%zu enc_ss=%zu dec_ss=%zu total=%zu\n",
	       sizeof(buffers->pk), sizeof(buffers->sk), sizeof(buffers->ct),
	       sizeof(buffers->enc_ss), sizeof(buffers->dec_ss), sizeof(*buffers));
	printk("LC_TIMER frequency_hz=%llu\n", (unsigned long long)sys_clock_hw_cycles_per_sec());
	return NULL;
}

ZTEST(TEST_SUITE_NAME, test_known_answer)
{
	struct buffers *buffers = test_buffers();
#ifndef CONFIG_TEST_LEANCRYPTO_BASELINE
	static const struct lc_rng fixed_rng = {.generate = fixed_generate};
	size_t offset = 0U;
	struct lc_rng_ctx fixed_ctx = {.rng = &fixed_rng, .rng_state = &offset};
	int result;

	zassert_ok(lc_rng_set_seeded(&fixed_ctx));
	result = run_operation(KEYGEN, buffers, "kat");
	zassert_ok(lc_rng_set_seeded(NULL));
	zassert_ok(result);
	zassert_equal(offset, 64U);
	check_digest(buffers->pk, sizeof(buffers->pk), kat_pk);
	check_digest(buffers->sk, sizeof(buffers->sk), kat_sk);

	zassert_ok(lc_rng_set_seeded(&fixed_ctx));
	result = run_operation(ENCAPSULATE, buffers, "kat");
	zassert_ok(lc_rng_set_seeded(NULL));
	zassert_ok(result);
	zassert_equal(offset, sizeof(kat_random));
	check_digest(buffers->ct, sizeof(buffers->ct), kat_ct);
	zassert_mem_equal(buffers->enc_ss, kat_ss, sizeof(kat_ss));

	zassert_ok(run_operation(DECAPSULATE, buffers, "kat"));
	zassert_mem_equal(buffers->dec_ss, kat_ss, sizeof(kat_ss));
#else
	zassert_ok(run_operation(KEYGEN, buffers, "baseline"));
	zassert_ok(run_operation(ENCAPSULATE, buffers, "baseline"));
	zassert_ok(run_operation(DECAPSULATE, buffers, "baseline"));
#endif
	memset(buffers, 0, sizeof(*buffers));
}

ZTEST(TEST_SUITE_NAME, test_random_round_trip)
{
	struct buffers *buffers = test_buffers();
#ifndef CONFIG_TEST_LEANCRYPTO_BASELINE
	size_t before = test_csrand_calls;
#endif

	zassert_ok(run_operation(KEYGEN, buffers, "random"));
	zassert_ok(run_operation(ENCAPSULATE, buffers, "random"));
	zassert_ok(run_operation(DECAPSULATE, buffers, "random"));
#ifndef CONFIG_TEST_LEANCRYPTO_BASELINE
	zassert_true(test_csrand_calls >= before + 2U, "Operations bypassed sys_csrand_get");
	zassert_mem_equal(buffers->enc_ss, buffers->dec_ss, sizeof(buffers->enc_ss));

	/* FIPS 203 implicit rejection: modified ciphertext must not recover the key. */
	buffers->ct[0] ^= 1U;
	zassert_ok(run_operation(DECAPSULATE, buffers, "invalid_ciphertext"));
	zassert_not_equal(memcmp(buffers->enc_ss, buffers->dec_ss, sizeof(buffers->enc_ss)), 0);
#endif
	memset(buffers, 0, sizeof(*buffers));
}

ZTEST(TEST_SUITE_NAME, test_random_failure)
{
#ifndef CONFIG_TEST_LEANCRYPTO_BASELINE
	struct buffers *buffers = test_buffers();
	uint8_t out[32];
	const uint8_t zeros[sizeof(out)] = {0};
	int keygen_result;
	int enc_result;
	int rng_result;

	zassert_ok(run_operation(KEYGEN, buffers, "failure_setup"));
	test_injected_error = -EIO;
	rng_result = lc_rng_generate(lc_seeded_rng, NULL, 0U, out, sizeof(out));
	keygen_result = run_operation(KEYGEN, buffers, "rng_failure");
	enc_result = run_operation(ENCAPSULATE, buffers, "rng_failure");
	test_injected_error = 0;
	zassert_equal(rng_result, -EIO);
	zassert_mem_equal(out, zeros, sizeof(out));
	zassert_equal(keygen_result, -EIO);
	zassert_equal(enc_result, -EIO);
	memset(buffers, 0, sizeof(*buffers));
#endif
}

ZTEST_SUITE(TEST_SUITE_NAME, NULL, suite_setup, NULL, NULL, NULL);
```

## src/kat.h
```c
/*
 * SPDX-FileCopyrightText: 2026 Embetrix Embedded Systems Solutions <ayoub.zaki@embetrix.com>
 * SPDX-License-Identifier: Apache-2.0
 */

#ifndef TESTS_CRYPTO_LEANCRYPTO_KAT_H_
#define TESTS_CRYPTO_LEANCRYPTO_KAT_H_

/*
 * LeanCrypto 65eb4e7e84e3a5499460a66b1623ccf6c59628b1:
 * ml-kem/src/kyber_selftest_vector_{512,768,1024}.h, first vector.
 * SHA3-256 digests cover every byte of pk, sk and ct. Expected digests
 * were computed with Python hashlib from the published vector bytes.
 * Random input is SHAKE128("")[:96]: d || z || m.
 */

static const uint8_t kat_random[] = {
	0x7f, 0x9c, 0x2b, 0xa4, 0xe8, 0x8f, 0x82, 0x7d, 0x61, 0x60, 0x45, 0x50,
	0x76, 0x05, 0x85, 0x3e, 0xd7, 0x3b, 0x80, 0x93, 0xf6, 0xef, 0xbc, 0x88,
	0xeb, 0x1a, 0x6e, 0xac, 0xfa, 0x66, 0xef, 0x26, 0x3c, 0xb1, 0xee, 0xa9,
	0x88, 0x00, 0x4b, 0x93, 0x10, 0x3c, 0xfb, 0x0a, 0xee, 0xfd, 0x2a, 0x68,
	0x6e, 0x01, 0xfa, 0x4a, 0x58, 0xe8, 0xa3, 0x63, 0x9c, 0xa8, 0xa1, 0xe3,
	0xf9, 0xae, 0x57, 0xe2, 0x35, 0xb8, 0xcc, 0x87, 0x3c, 0x23, 0xdc, 0x62,
	0xb8, 0xd2, 0x60, 0x16, 0x9a, 0xfa, 0x2f, 0x75, 0xab, 0x91, 0x6a, 0x58,
	0xd9, 0x74, 0x91, 0x88, 0x35, 0xd2, 0x5e, 0x6a, 0x43, 0x50, 0x85, 0xb2,
};

#if TEST_KEM_BITS == 512

static const uint8_t kat_pk[] = {
	0xcd, 0xa9, 0x3d, 0xec, 0x4c, 0x4d, 0xc4, 0xd8, 0x48, 0x44, 0x57, 0xfd,
	0x88, 0x23, 0x99, 0xc4, 0xb9, 0x18, 0xc4, 0x9f, 0xa8, 0x38, 0x9a, 0x1d,
	0xfa, 0x8c, 0x9f, 0x92, 0xf3, 0x9b, 0x00, 0xcf,
};

static const uint8_t kat_sk[] = {
	0xca, 0x76, 0xd5, 0xa1, 0xfb, 0x88, 0xcc, 0x3c, 0xed, 0x2c, 0xa5, 0xb6,
	0xb4, 0xc5, 0x34, 0x09, 0xed, 0xee, 0x55, 0xca, 0x98, 0x42, 0x62, 0xd5,
	0x4e, 0x77, 0xaa, 0x05, 0xfc, 0x60, 0x4a, 0x76,
};

static const uint8_t kat_ct[] = {
	0x79, 0x01, 0xa6, 0xfc, 0xc8, 0xd1, 0x75, 0x34, 0xf3, 0x25, 0x3a, 0x0a,
	0x8c, 0x98, 0xa1, 0xed, 0xb6, 0x20, 0x06, 0x29, 0x7f, 0x28, 0xca, 0x3f,
	0x93, 0x26, 0xa4, 0xc7, 0x7d, 0x68, 0x76, 0xb5,
};

static const uint8_t kat_ss[] = {
	0x22, 0x1d, 0x7d, 0x86, 0x01, 0x16, 0x59, 0x31, 0x3c, 0x83, 0xce, 0x3f,
	0xd0, 0xab, 0x26, 0x79, 0x7e, 0xf2, 0x17, 0xe1, 0x1d, 0x1f, 0x0b, 0xc7,
	0x6e, 0x79, 0x52, 0xfb, 0xe5, 0x2a, 0x0a, 0x58,
};
#elif TEST_KEM_BITS == 1024

static const uint8_t kat_pk[] = {
	0x06, 0x81, 0x5e, 0xd5, 0x7d, 0x48, 0xce, 0xd9, 0x74, 0xe2, 0xd3, 0x04,
	0x22, 0xba, 0x60, 0xed, 0xcf, 0x86, 0x11, 0x50, 0xb9, 0x3e, 0x96, 0x85,
	0x00, 0xca, 0x42, 0x1d, 0x90, 0xdd, 0xd4, 0xa1,
};

static const uint8_t kat_sk[] = {
	0xf4, 0xa4, 0xce, 0x52, 0x34, 0x32, 0x4e, 0xe3, 0x88, 0x26, 0xb8, 0xd0,
	0xec, 0x42, 0xb0, 0x77, 0xe1, 0x6a, 0x29, 0xb7, 0x17, 0xb6, 0x65, 0x2e,
	0x3f, 0x1d, 0x84, 0x43, 0x03, 0x56, 0x02, 0x0b,
};

static const uint8_t kat_ct[] = {
	0xb4, 0x36, 0x0c, 0xa1, 0xdc, 0x92, 0x54, 0x16, 0xec, 0xed, 0x41, 0xe3,
	0x0a, 0x3c, 0xec, 0x6e, 0x09, 0x2b, 0x44, 0x42, 0x7e, 0xbc, 0xc6, 0x71,
	0x11, 0xe2, 0x8b, 0xb8, 0x44, 0x74, 0xdb, 0xab,
};

static const uint8_t kat_ss[] = {
	0x36, 0xd8, 0x25, 0xed, 0x3e, 0x16, 0x8e, 0xb7, 0x55, 0x1c, 0x83, 0xb6,
	0x3c, 0x38, 0x45, 0x4e, 0x31, 0xd9, 0x4d, 0x33, 0xda, 0x9c, 0x3b, 0xc7,
	0x66, 0x24, 0x4c, 0xe4, 0xd4, 0xcb, 0x64, 0x0c,
};
#else

static const uint8_t kat_pk[] = {
	0x28, 0xb8, 0x74, 0x69, 0xd4, 0xee, 0x89, 0x06, 0xec, 0x34, 0xdb, 0xa7,
	0x6c, 0x68, 0xd8, 0xa8, 0x22, 0x8d, 0xf3, 0x3c, 0xcf, 0x3a, 0x80, 0xbf,
	0x15, 0x6b, 0x29, 0x53, 0xa5, 0x31, 0x26, 0x9f,
};

static const uint8_t kat_sk[] = {
	0x7e, 0x8e, 0xd3, 0x16, 0xf3, 0x83, 0xc1, 0x0e, 0x54, 0x92, 0x90, 0xce,
	0x7b, 0xaf, 0x4d, 0xb5, 0xb0, 0x77, 0xe2, 0x4c, 0xf4, 0x14, 0x5f, 0x40,
	0x82, 0x25, 0x2a, 0xfe, 0x40, 0xbf, 0x15, 0x5d,
};

static const uint8_t kat_ct[] = {
	0xba, 0xa1, 0xfe, 0x38, 0x15, 0xaa, 0x23, 0x55, 0xda, 0xf4, 0xd4, 0xe8,
	0x0d, 0x70, 0x16, 0x6e, 0xff, 0x20, 0xae, 0x66, 0x88, 0x23, 0x98, 0xdf,
	0x6e, 0xc3, 0x8f, 0x9d, 0xc3, 0xb7, 0x21, 0xc7,
};

static const uint8_t kat_ss[] = {
	0xfe, 0x62, 0x76, 0x21, 0xfe, 0x29, 0x61, 0x86, 0xfc, 0xe3, 0x22, 0x43,
	0xdd, 0x55, 0x4b, 0xdd, 0xa3, 0x89, 0x71, 0xb4, 0x7f, 0x18, 0x46, 0x1f,
	0x21, 0x32, 0x37, 0x82, 0xdf, 0xe5, 0xff, 0x89,
};
#endif

#endif /* TESTS_CRYPTO_LEANCRYPTO_KAT_H_ */
```

## src/mldsa.c
```c
/*
 * SPDX-FileCopyrightText: 2026 Embetrix Embedded Systems Solutions <ayoub.zaki@embetrix.com>
 * SPDX-License-Identifier: Apache-2.0
 */

#include <zephyr/kernel.h>
#include <zephyr/random/random.h>
#include <zephyr/ztest.h>

#include "test_support.h"

#ifndef TEST_DSA_BITS
#if defined(CONFIG_TEST_LEANCRYPTO_ML_DSA_44)
#define TEST_DSA_BITS 44
#elif defined(CONFIG_TEST_LEANCRYPTO_ML_DSA_65)
#define TEST_DSA_BITS 65
#else
#define TEST_DSA_BITS 87
#endif
#endif

#ifndef TEST_SUITE_NAME
#define TEST_SUITE_NAME leancrypto_mldsa
#endif

#ifndef CONFIG_TEST_LEANCRYPTO_BASELINE
#if TEST_DSA_BITS == 44
#include <lc_dilithium_44.h>
#elif TEST_DSA_BITS == 65
#include <lc_dilithium_65.h>
#else
#include <lc_dilithium_87.h>
#endif
#include <lc_hash.h>
#include <lc_sha3.h>
#include "mldsa_kat.h"
#endif

#if TEST_DSA_BITS == 44
#define TEST_DSA(name) lc_dilithium_44_##name
#define TEST_PK_SIZE 1312
#define TEST_SK_SIZE 2560
#define TEST_SIG_SIZE 2420
#elif TEST_DSA_BITS == 65
#define TEST_DSA(name) lc_dilithium_65_##name
#define TEST_PK_SIZE 1952
#define TEST_SK_SIZE 4032
#define TEST_SIG_SIZE 3309
#else
#define TEST_DSA(name) lc_dilithium_87_##name
#define TEST_PK_SIZE 2592
#define TEST_SK_SIZE 4896
#define TEST_SIG_SIZE 4627
#endif

enum operation {
	KEYGEN,
	SIGN,
	VERIFY,
};

/* Identical caller-owned storage in the crypto and baseline images. */
struct buffers {
	uint8_t pk[TEST_PK_SIZE];
	uint8_t sk[TEST_SK_SIZE];
	uint8_t sig[TEST_SIG_SIZE];
	uint8_t message[64];
};

static struct buffers *test_buffers(void)
{
	static struct buffers buffers __aligned(8);

	return &buffers;
}

struct job {
	enum operation operation;
	struct buffers *buffers;
	int result;
	uint32_t cycles;
	bool deterministic;
};

#ifndef CONFIG_TEST_LEANCRYPTO_BASELINE
BUILD_ASSERT(sizeof(struct TEST_DSA(pk)) == sizeof(((struct buffers *)0)->pk));
BUILD_ASSERT(sizeof(struct TEST_DSA(sk)) == sizeof(((struct buffers *)0)->sk));
BUILD_ASSERT(sizeof(struct TEST_DSA(sig)) == sizeof(((struct buffers *)0)->sig));

static int fixed_generate(void *state, const uint8_t *additional,
			  size_t additional_len, uint8_t *out, size_t len)
{
	size_t *offset = state;

	ARG_UNUSED(additional);
	ARG_UNUSED(additional_len);
	if (len > sizeof(kat_seed) - *offset) {
		return -ENODATA;
	}
	memcpy(out, &kat_seed[*offset], len);
	*offset += len;
	return 0;
}

static void check_digest(const uint8_t *data, size_t len, const uint8_t *expected)
{
	uint8_t digest[32];

	zassert_ok(lc_hash(lc_sha3_256, data, len, digest));
	zassert_mem_equal(digest, expected, sizeof(digest));
}
#endif

static void operation_entry(void *arg, void *unused1, void *unused2)
{
	struct job *job = arg;
	struct buffers *b = job->buffers;

	ARG_UNUSED(unused1);
	ARG_UNUSED(unused2);
	job->cycles = k_cycle_get_32();
#ifdef CONFIG_TEST_LEANCRYPTO_BASELINE
	/* Retain all caller buffers and the same CSPRNG in the baseline. */
	job->result = sys_csrand_get(b, sizeof(*b));
#else
	switch (job->operation) {
	case KEYGEN:
		job->result = TEST_DSA(keypair)((struct TEST_DSA(pk) *)b->pk,
					       (struct TEST_DSA(sk) *)b->sk, NULL);
		break;
	case SIGN:
		job->result = TEST_DSA(sign)((struct TEST_DSA(sig) *)b->sig,
					     b->message, sizeof(b->message),
					     (const struct TEST_DSA(sk) *)b->sk,
					     job->deterministic ? NULL : lc_seeded_rng);
		break;
	case VERIFY:
		job->result = TEST_DSA(verify)((const struct TEST_DSA(sig) *)b->sig,
					       b->message, sizeof(b->message),
					       (const struct TEST_DSA(pk) *)b->pk);
		break;
	}
#endif
	job->cycles = k_cycle_get_32() - job->cycles;
}

static int run_operation(enum operation operation, struct buffers *buffers, const char *mode,
			 bool deterministic)
{
	static const char *const names[] = {"keygen", "sign", "verify"};
	struct job job = {
		.operation = operation,
		.buffers = buffers,
		.result = -EINPROGRESS,
		.deterministic = deterministic,
	};
	size_t unused;
	size_t usable;

	/* Recreating a joined thread repaints the entire stack with CONFIG_INIT_STACKS. */
	k_thread_create(&test_operation_thread, test_operation_stack,
			K_THREAD_STACK_SIZEOF(test_operation_stack), operation_entry,
			&job, NULL, NULL, K_PRIO_PREEMPT(1), 0, K_FOREVER);
	usable = test_operation_thread.stack_info.size;
	k_thread_start(&test_operation_thread);
	zassert_ok(k_thread_join(&test_operation_thread, K_SECONDS(60)));
	zassert_ok(k_thread_stack_space_get(&test_operation_thread, &unused));
	zassert_true(unused <= usable);
	zassert_true(unused >= 256U, "Insufficient stack headroom");
	printk("LC_STACK mode=%s op=%s peak=%zu usable=%zu reserved=%zu caller=%zu heap=0\n",
	       mode, names[operation], usable - unused, usable, sizeof(test_operation_stack),
	       sizeof(*buffers));
	printk("LC_TIME mode=%s op=%s cycles=%u duration_us=%llu result=%d\n",
	       mode, names[operation], job.cycles,
	       (unsigned long long)k_cyc_to_us_floor64(job.cycles), job.result);
	return job.result;
}

static void *suite_setup(void)
{
	struct buffers *buffers = test_buffers();

	printk("LC_PARAMETER_SET ML-DSA-%d\n", TEST_DSA_BITS);
	printk("LC_BUFFERS unit=bytes pk=%zu sk=%zu sig=%zu message=%zu total=%zu\n",
	       sizeof(buffers->pk), sizeof(buffers->sk), sizeof(buffers->sig),
	       sizeof(buffers->message), sizeof(*buffers));
	printk("LC_TIMER frequency_hz=%llu\n", (unsigned long long)sys_clock_hw_cycles_per_sec());
	return NULL;
}

ZTEST(TEST_SUITE_NAME, test_known_answer)
{
	struct buffers *buffers = test_buffers();
#ifndef CONFIG_TEST_LEANCRYPTO_BASELINE
	static const struct lc_rng fixed_rng = {.generate = fixed_generate};
	size_t offset = 0U;
	struct lc_rng_ctx fixed_ctx = {.rng = &fixed_rng, .rng_state = &offset};
	int result;

	memcpy(buffers->message, kat_msg, sizeof(kat_msg));
	zassert_ok(lc_rng_set_seeded(&fixed_ctx));
	result = run_operation(KEYGEN, buffers, "kat", true);
	zassert_ok(lc_rng_set_seeded(NULL));
	zassert_ok(result);
	zassert_equal(offset, sizeof(kat_seed));
	check_digest(buffers->pk, sizeof(buffers->pk), kat_pk);
	check_digest(buffers->sk, sizeof(buffers->sk), kat_sk);

	zassert_ok(run_operation(SIGN, buffers, "kat", true));
	check_digest(buffers->sig, sizeof(buffers->sig), kat_sig);
	zassert_ok(run_operation(VERIFY, buffers, "kat", true));
#else
	zassert_ok(run_operation(KEYGEN, buffers, "baseline", false));
	zassert_ok(run_operation(SIGN, buffers, "baseline", false));
	zassert_ok(run_operation(VERIFY, buffers, "baseline", false));
#endif
	memset(buffers, 0, sizeof(*buffers));
}

ZTEST(TEST_SUITE_NAME, test_random_sign_verify)
{
	struct buffers *buffers = test_buffers();
#ifndef CONFIG_TEST_LEANCRYPTO_BASELINE
	size_t before;

	zassert_ok(sys_csrand_get(buffers->message, sizeof(buffers->message)));
	before = test_csrand_calls;
#endif
	zassert_ok(run_operation(KEYGEN, buffers, "random", false));
#ifndef CONFIG_TEST_LEANCRYPTO_BASELINE
	zassert_true(test_csrand_calls > before, "Key generation bypassed sys_csrand_get");
	before = test_csrand_calls;
#endif
	zassert_ok(run_operation(SIGN, buffers, "random", false));
#ifndef CONFIG_TEST_LEANCRYPTO_BASELINE
	zassert_true(test_csrand_calls > before, "Signing bypassed sys_csrand_get");
#endif
	zassert_ok(run_operation(VERIFY, buffers, "random", false));
#ifndef CONFIG_TEST_LEANCRYPTO_BASELINE
	buffers->message[0] ^= 1U;
	zassert_true(run_operation(VERIFY, buffers, "invalid_message", false) < 0);
	buffers->message[0] ^= 1U;
	buffers->sig[0] ^= 1U;
	zassert_true(run_operation(VERIFY, buffers, "invalid_signature", false) < 0);
#endif
	memset(buffers, 0, sizeof(*buffers));
}

ZTEST(TEST_SUITE_NAME, test_random_failure)
{
#ifndef CONFIG_TEST_LEANCRYPTO_BASELINE
	struct buffers *buffers = test_buffers();
	uint8_t out[32];
	const uint8_t zeros[sizeof(out)] = {0};
	int keygen_result;
	int sign_result;
	int rng_result;

	zassert_ok(run_operation(KEYGEN, buffers, "failure_setup", false));
	test_injected_error = -EIO;
	rng_result = lc_rng_generate(lc_seeded_rng, NULL, 0U, out, sizeof(out));
	keygen_result = run_operation(KEYGEN, buffers, "rng_failure", false);
	sign_result = run_operation(SIGN, buffers, "rng_failure", false);
	test_injected_error = 0;
	zassert_equal(rng_result, -EIO);
	zassert_mem_equal(out, zeros, sizeof(out));
	zassert_equal(keygen_result, -EIO);
	zassert_equal(sign_result, -EIO);
	memset(buffers, 0, sizeof(*buffers));
#endif
}

ZTEST_SUITE(TEST_SUITE_NAME, NULL, suite_setup, NULL, NULL, NULL);
```

## src/mldsa_kat.h
```c
/*
 * SPDX-FileCopyrightText: 2026 Embetrix Embedded Systems Solutions <ayoub.zaki@embetrix.com>
 * SPDX-License-Identifier: Apache-2.0
 */

#ifndef TESTS_CRYPTO_LEANCRYPTO_MLDSA_KAT_H_
#define TESTS_CRYPTO_LEANCRYPTO_MLDSA_KAT_H_

/*
 * LeanCrypto 65eb4e7e84e3a5499460a66b1623ccf6c59628b1:
 * ml-dsa/tests/dilithium_pure_rejection_vectors_{44,65,87}.h, first vector.
 * Python hashlib SHA3-256 digests cover the published pk, sk, and signature.
 * The vector uses pure ML-DSA, an empty context, and deterministic signing.
 */

#if TEST_DSA_BITS == 44

static const uint8_t kat_seed[] = {
	0x51, 0x83, 0x8e, 0x29, 0xe8, 0xfe, 0x1f, 0x35, 0x7a, 0x65, 0x6a, 0xc1,
	0x06, 0x25, 0x48, 0x56, 0xd8, 0xf0, 0xde, 0x83, 0xd3, 0x9d, 0xd9, 0xc4,
	0x31, 0x33, 0x4c, 0xfa, 0x6a, 0xc0, 0x40, 0xb0,
};

static const uint8_t kat_msg[] = {
	0x6d, 0xb3, 0x8e, 0x80, 0xaf, 0x5f, 0x19, 0xd9, 0xb0, 0xcf, 0xad, 0x58,
	0xc7, 0x27, 0xae, 0x12, 0x4e, 0x7d, 0xa3, 0x1a, 0xe3, 0x85, 0xc6, 0xaa,
	0xf6, 0xa1, 0x9a, 0xb1, 0xe9, 0xe0, 0xfe, 0x89, 0x1e, 0xc5, 0x6f, 0x10,
	0x18, 0x24, 0xab, 0xa8, 0x6d, 0x03, 0xd0, 0x3d, 0xc3, 0xff, 0x67, 0xe7,
	0x3a, 0x95, 0x94, 0xc8, 0x49, 0x51, 0x8f, 0xa0, 0x65, 0xcb, 0x20, 0x29,
	0x2a, 0x6d, 0xf7, 0xf2,
};

static const uint8_t kat_pk[] = {
	0x81, 0xb5, 0x7a, 0xa0, 0x42, 0x69, 0xf3, 0x4e, 0x06, 0x0e, 0x3f, 0x35,
	0x44, 0xaf, 0x94, 0x07, 0xf2, 0x42, 0xb2, 0xc1, 0x50, 0x72, 0x3a, 0xb7,
	0x49, 0x25, 0xeb, 0x3a, 0xd5, 0xd8, 0x01, 0xcb,
};

static const uint8_t kat_sk[] = {
	0x76, 0xe1, 0x38, 0xa8, 0x9c, 0xfc, 0xf5, 0x95, 0x5d, 0x45, 0x05, 0x2f,
	0xfc, 0xc5, 0x2f, 0x21, 0xd5, 0xc9, 0x68, 0x89, 0xce, 0x57, 0xf4, 0x2c,
	0xf4, 0x95, 0x25, 0x3b, 0x5f, 0xb8, 0x24, 0xfa,
};

static const uint8_t kat_sig[] = {
	0xd0, 0x9e, 0x21, 0xf9, 0xb0, 0x96, 0x19, 0x8a, 0x99, 0xc8, 0x24, 0x62,
	0xc3, 0x1e, 0xe0, 0xca, 0xd3, 0x1d, 0x5f, 0xae, 0xef, 0xc1, 0x87, 0x62,
	0xfb, 0x0e, 0x31, 0xe0, 0xa3, 0xe4, 0x91, 0xc1,
};
#elif TEST_DSA_BITS == 65

static const uint8_t kat_seed[] = {
	0x9d, 0x88, 0x1c, 0x3a, 0x88, 0xa1, 0xed, 0xf5, 0x05, 0xec, 0xcd, 0x12,
	0xc9, 0x2f, 0x8d, 0x0b, 0xe6, 0xfc, 0x3a, 0xa2, 0xd6, 0xe0, 0x95, 0xe7,
	0x87, 0x3b, 0x45, 0x80, 0x29, 0x55, 0xc4, 0xbb,
};

static const uint8_t kat_msg[] = {
	0x1a, 0x84, 0x21, 0x0d, 0x35, 0x7a, 0x88, 0xc8, 0x6a, 0x11, 0xe3, 0x15,
	0x24, 0xec, 0x0d, 0x2e, 0x76, 0xb9, 0xcf, 0x2b, 0x04, 0x25, 0x16, 0xae,
	0x62, 0x42, 0xa0, 0x20, 0x68, 0x25, 0x3e, 0xb4, 0x75, 0xa7, 0x1d, 0x64,
	0xc3, 0xd1, 0x08, 0x07, 0x67, 0xb6, 0xf7, 0x76, 0x76, 0xf6, 0xd6, 0x62,
	0x66, 0x04, 0x89, 0x0c, 0x8f, 0x07, 0xac, 0xc8, 0x51, 0x77, 0xd9, 0x47,
	0x5e, 0xb5, 0x22, 0x20,
};

static const uint8_t kat_pk[] = {
	0x5a, 0x4d, 0xd1, 0xc2, 0xc1, 0x2a, 0x07, 0x59, 0x3c, 0x92, 0x05, 0x31,
	0xef, 0x09, 0x1c, 0xa8, 0xd7, 0x61, 0x17, 0x9e, 0x80, 0x9d, 0xc8, 0xc4,
	0x2a, 0xc7, 0x0b, 0xdf, 0x16, 0xf6, 0x3a, 0x6f,
};

static const uint8_t kat_sk[] = {
	0x99, 0x03, 0x02, 0xd8, 0x02, 0x36, 0x50, 0x51, 0x32, 0x60, 0xe5, 0x60,
	0xcc, 0xc9, 0x4f, 0x3d, 0x7e, 0x95, 0x14, 0x8e, 0x3c, 0x22, 0x24, 0xa7,
	0x3a, 0xf6, 0x76, 0xad, 0xb1, 0x47, 0xf6, 0xf6,
};

static const uint8_t kat_sig[] = {
	0x4f, 0x91, 0x6b, 0xa5, 0xdf, 0xb0, 0xb9, 0x2d, 0xba, 0x52, 0xb8, 0xd9,
	0xb7, 0xef, 0xa3, 0x1c, 0xec, 0x7e, 0xcb, 0xad, 0x9b, 0x52, 0x7b, 0xa0,
	0xfe, 0xff, 0x69, 0x98, 0x8d, 0x09, 0x84, 0x03,
};
#else

static const uint8_t kat_seed[] = {
	0x8c, 0x4c, 0xf5, 0x31, 0xc6, 0xd4, 0x2b, 0x74, 0x4c, 0xec, 0x18, 0x94,
	0x08, 0xdf, 0xac, 0xcb, 0xd7, 0xb5, 0xc8, 0x9a, 0x71, 0xc9, 0x1e, 0x72,
	0x77, 0x7c, 0xeb, 0x71, 0x80, 0x50, 0xe4, 0x57,
};

static const uint8_t kat_msg[] = {
	0x48, 0x11, 0x92, 0xb3, 0xaa, 0x7e, 0xb3, 0x14, 0xdc, 0x46, 0xd6, 0xbf,
	0x26, 0xb2, 0x66, 0xc5, 0xd8, 0xc4, 0x69, 0x9f, 0x67, 0x50, 0x67, 0xc0,
	0x3b, 0x8d, 0xc5, 0xb5, 0x68, 0x59, 0x6f, 0x9c, 0xd4, 0xf2, 0x49, 0xfb,
	0xa4, 0xd0, 0xbf, 0xc5, 0x3c, 0xee, 0x3b, 0x03, 0x25, 0x6c, 0x51, 0x94,
	0xb3, 0xd4, 0xdb, 0x2a, 0xbd, 0x26, 0xef, 0x58, 0xb3, 0x91, 0x62, 0x81,
	0x1b, 0x29, 0x9c, 0x12,
};

static const uint8_t kat_pk[] = {
	0x4f, 0x57, 0x6d, 0x44, 0xd4, 0xa8, 0x32, 0xa1, 0x7a, 0x77, 0xcf, 0x4f,
	0x9f, 0x9a, 0x84, 0x4c, 0x8e, 0x41, 0x16, 0x12, 0xbd, 0x4f, 0x12, 0x01,
	0xbf, 0x6a, 0x16, 0xef, 0x35, 0xec, 0x5c, 0x39,
};

static const uint8_t kat_sk[] = {
	0xd4, 0x5e, 0x83, 0xc9, 0x51, 0xa8, 0x90, 0x44, 0x46, 0x73, 0xec, 0xf1,
	0x5a, 0x4b, 0xbb, 0xff, 0xd5, 0x3f, 0xd0, 0xfb, 0x15, 0x8d, 0x47, 0xe3,
	0x5c, 0xad, 0x2e, 0x46, 0x71, 0x3a, 0x4d, 0x4f,
};

static const uint8_t kat_sig[] = {
	0xd6, 0xba, 0x68, 0x05, 0x45, 0x61, 0x16, 0xcb, 0xe4, 0x56, 0x65, 0x7b,
	0xd9, 0xc1, 0x7b, 0x1b, 0xc7, 0xa9, 0x6e, 0x2e, 0x7e, 0x4a, 0xef, 0x61,
	0xfe, 0x5c, 0x21, 0xfd, 0x04, 0xa7, 0x68, 0xba,
};
#endif

#endif /* TESTS_CRYPTO_LEANCRYPTO_MLDSA_KAT_H_ */
```

## src/test_support.c
```c
/*
 * SPDX-FileCopyrightText: 2026 Embetrix Embedded Systems Solutions <ayoub.zaki@embetrix.com>
 * SPDX-License-Identifier: Apache-2.0
 */

#include <string.h>

#include "test_support.h"

K_THREAD_STACK_DEFINE(test_operation_stack, CONFIG_TEST_LEANCRYPTO_STACK_SIZE);
struct k_thread test_operation_thread;

#ifndef CONFIG_TEST_LEANCRYPTO_BASELINE
int test_injected_error;
size_t test_csrand_calls;

int __real_z_impl_sys_csrand_get(void *dst, size_t len);
int __wrap_z_impl_sys_csrand_get(void *dst, size_t len);

int __wrap_z_impl_sys_csrand_get(void *dst, size_t len)
{
	test_csrand_calls++;
	if (test_injected_error != 0) {
		/* Model a provider which writes partial output before failing. */
		memset(dst, 0xa5, len);
		return test_injected_error;
	}
	return __real_z_impl_sys_csrand_get(dst, len);
}
#endif
```

## src/test_support.h
```c
/*
 * SPDX-FileCopyrightText: 2026 Embetrix Embedded Systems Solutions <ayoub.zaki@embetrix.com>
 * SPDX-License-Identifier: Apache-2.0
 */

#ifndef TESTS_CRYPTO_LEANCRYPTO_TEST_SUPPORT_H_
#define TESTS_CRYPTO_LEANCRYPTO_TEST_SUPPORT_H_

#include <zephyr/kernel.h>

/* Suites run sequentially; every operation recreates and joins this worker. */
K_THREAD_STACK_DECLARE(test_operation_stack, CONFIG_TEST_LEANCRYPTO_STACK_SIZE);
extern struct k_thread test_operation_thread;

#ifndef CONFIG_TEST_LEANCRYPTO_BASELINE
extern int test_injected_error;
extern size_t test_csrand_calls;
#endif

#endif /* TESTS_CRYPTO_LEANCRYPTO_TEST_SUPPORT_H_ */
```
